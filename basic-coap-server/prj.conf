## prj.conf
```kconfig
# Library options
CONFIG_NEWLIB_LIBC=y

# GPIOs for LED control.
CONFIG_GPIO=y

# Generic networking options
CONFIG_NETWORKING=y
CONFIG_NET_UDP=y
CONFIG_NET_IPV6=y
CONFIG_NET_CONFIG_NEED_IPV6=y
CONFIG_POSIX_MAX_FDS=12
CONFIG_NET_CONNECTION_MANAGER=y
CONFIG_NET_IPV6_NBR_CACHE=n
CONFIG_NET_IPV6_MLD=n
CONFIG_NET_CONFIG_SETTINGS=y

# Network options not relevant for OpenThread
CONFIG_NET_TCP=n
CONFIG_NET_IPV4=n
CONFIG_NET_CONFIG_NEED_IPV4=n

# IP address options
CONFIG_NET_IF_UNICAST_IPV6_ADDR_COUNT=3
CONFIG_NET_IF_MCAST_IPV6_ADDR_COUNT=5
CONFIG_NET_MAX_CONTEXTS=10

# Sockets
CONFIG_NET_SOCKETS=y
CONFIG_NET_SOCKETS_POSIX_NAMES=y
CONFIG_NET_SOCKETS_POLL_MAX=4

# Network buffers
CONFIG_NET_PKT_RX_COUNT=16
CONFIG_NET_PKT_TX_COUNT=16
CONFIG_NET_BUF_RX_COUNT=64
CONFIG_NET_BUF_TX_COUNT=64
CONFIG_NET_CONTEXT_NET_PKT_POOL=y

# OpenThread
CONFIG_NET_L2_OPENTHREAD=y
CONFIG_OPENTHREAD_DEBUG=y
CONFIG_OPENTHREAD_L2_DEBUG=y
CONFIG_OPENTHREAD_L2_LOG_LEVEL_INF=y
CONFIG_OPENTHREAD_CHANNEL=26
#CONFIG_OPENTHREAD_COMMISSIONER=y
#CONFIG_OPENTHREAD_DIAG=y

# mbedTLS tweaks
CONFIG_MBEDTLS_SSL_MAX_CONTENT_LEN=768

# CoAP
CONFIG_COAP=y
CONFIG_COAP_WELL_KNOWN_BLOCK_WISE=n

# Kernel options
CONFIG_MAIN_STACK_SIZE=4096
CONFIG_SYSTEM_WORKQUEUE_STACK_SIZE=4096
CONFIG_HEAP_MEM_POOL_SIZE=2048
CONFIG_ENTROPY_GENERATOR=y
CONFIG_INIT_STACKS=y

# Logging
CONFIG_LOG=y
CONFIG_NET_LOG=y
CONFIG_PRINTK=y
CONFIG_NET_STATISTICS=y

# Network shell including OpenThread
CONFIG_SHELL=y
CONFIG_NET_SHELL=y
CONFIG_OPENTHREAD_SHELL=y
CONFIG_SHELL_STACK_SIZE=3072

# IPv6 address options
CONFIG_NET_CONFIG_MY_IPV6_ADDR="2001:db8::1"
CONFIG_NET_IF_MCAST_IPV6_ADDR_COUNT=5
```

## src/main.c
```c
// Basic OpenThread CoAP server.
//
// Originally derived from Zephyr net/socket/coap_server and
// net/socket/echo_server examples.

#include <logging/log.h>
LOG_MODULE_REGISTER(basic_coap_server, LOG_LEVEL_DBG);

#include <zephyr.h>
#include <errno.h>
#include <shell/shell.h>
#include <sys/printk.h>

#include <net/net_ip.h>
#include <net/net_mgmt.h>
#include <net/net_event.h>
#include <net/net_conn_mgr.h>

#include "coap.h"
#include "led.h"
#include "endpoints.h"


// ----------------------------------------------------------------------
// CONNECTION STATE MANAGEMENT

// Is the network connected?
static bool connected;

// Sempahore used to hold off application initialisation until a valid
// network connection is there.
K_SEM_DEFINE(run_app, 0, 1);

// Quit flag used to communicate between shell command and management
// callback.
static bool want_to_quit;

// Detect network connected and disconnected events.
#define EVENT_MASK (NET_EVENT_L4_CONNECTED | NET_EVENT_L4_DISCONNECTED)


static void event_handler(struct net_mgmt_event_callback *cb,
                          uint32_t mgmt_event, struct net_if *iface) {
  // Ignore any events we didn't ask for.
  if ((mgmt_event & EVENT_MASK) != mgmt_event) return;

  // Handle quitting.
  if (want_to_quit) {
    k_sem_give(&run_app);
    want_to_quit = false;
  }

  // If we're connected, flag it and release the semaphore that holds
  // off application initialisation.
  if (mgmt_event == NET_EVENT_L4_CONNECTED) {
    LOG_INF("Network connected");
    connected = true;
    k_sem_give(&run_app);
    return;
  }

  // If we're disconnected, flag it and reset the semaphore that holds
  // off application initialisation.
  // ==> NOTE: I'M NOT SURE WHAT THIS REALLY DOES ONCE THE CoAP SERVER
  // IS RUNNING. IT CERTAINLY DOESN'T STOP IT. IN A REAL APPLICATION,
  // YOU WOULD WANT TO BE MORE CAREFUL ABOUT WHAT HAPPENS AS NETWORK
  // CONNECTIONS COME AND GO.
  if (mgmt_event == NET_EVENT_L4_DISCONNECTED) {
    if (!connected) {
      LOG_INF("Waiting network to be connected");
    } else {
      LOG_INF("Network disconnected");
      connected = false;
    }

    k_sem_reset(&run_app);
    return;
  }
}

// Semaphore and command to signal it used for shutting down the CoAP
// server.

static struct k_sem quit_lock;

void quit(void) { k_sem_give(&quit_lock); }


// Initialise network connection management. All connection events go
// via the event_handler callback, which is used to trigger
// application initialisation when a connected network is detected.

static struct net_mgmt_event_callback mgmt_cb;

static void init_app(void) {
  // Set up the "quit" semaphore.
  k_sem_init(&quit_lock, 0, UINT_MAX);

  LOG_INF("Basic CoAP server");

  // Initialise LED GPIO.
  init_led();

  // Initialise network connection callback.
  net_mgmt_init_event_callback(&mgmt_cb, event_handler, EVENT_MASK);
  net_mgmt_add_event_callback(&mgmt_cb);

  // Trigger initial call to event handler callback with current
  // connection status.
  net_conn_mgr_resend_status();
}


// ----------------------------------------------------------------------
// SHELL COMMANDS

// Add shell command to stop CoAP server application. This is
// accessible as "basic_coap quit" in the Zephyr shell.

static int cmd_quit(const struct shell *shell, size_t argc, char *argv[]) {
  // Slightly sneaky: just set a flag and use the "resend status" API
  // to trigger a call into the network connection management event
  // handler callback.
  want_to_quit = true;
  net_conn_mgr_resend_status();
  quit();
  return 0;
}

SHELL_STATIC_SUBCMD_SET_CREATE
  (basic_coap_commands,
   SHELL_CMD(quit, NULL, "Quit the basic CoAP server application\n", cmd_quit),
   SHELL_SUBCMD_SET_END);

SHELL_CMD_REGISTER
  (basic_coap, &basic_coap_commands, "Basic CoAP server application commands",
   NULL);


// ----------------------------------------------------------------------
// MAIN PROGRAM

void main(void) {
  // Initialise application start semaphore and network connection
  // management API.
  init_app();

  // Wait for OpenThread connection.
  k_sem_take(&run_app, K_FOREVER);

  // Start CoAP handler thread.
  LOG_INF("Starting...");
  start_coap();

  // Wait for shell "basic_coap quit" command.
  k_sem_take(&quit_lock, K_FOREVER);

  // Kill CoAP server thread if it's running.
  if (connected) {
    LOG_INF("Stopping...");
    stop_coap();
  }

  LOG_DBG("Done");
}
```

## src/coap-server.c
```c
// Basic OpenThread CoAP server.
//
// Originally derived from Zephyr net/socket/coap_server and
// net/socket/echo_server examples.

#include <logging/log.h>
LOG_MODULE_REGISTER(basic_coap_server, LOG_LEVEL_DBG);

#include <zephyr.h>
#include <errno.h>
#include <shell/shell.h>
#include <sys/printk.h>

#include <net/coap.h>
#include <net/coap_link_format.h>
#include <net/net_ip.h>
#include <net/net_mgmt.h>
#include <net/net_event.h>
#include <net/net_conn_mgr.h>
#include <net/socket.h>
#include <net/udp.h>


static inline void hexdump(const char *str, const uint8_t *pkt, size_t len) {
  if (!len) {
    LOG_DBG("%s zero-length packet", str);
    return;
  }
  LOG_HEXDUMP_DBG(pkt, len, str);
}

// ==> QUESTION: IS THIS DEFINED BY THE PROTOCOL, OR JUST AN
// APPLICATION LIMIT HERE?
#define MAX_COAP_MSG_LEN 256

// This is the IANA assigned port for CoAP.
#define COAP_PORT 5683

// This is the link local (FF02) version of the "All CoAP Nodes"
// address FF0X::FD, from the "IPv6 Multicast Address Space Registry",
// in the "Variable Scope Multicast Addresses" space (RFC 3307).
#define ALL_NODES_LOCAL_COAP_MCAST {{{0xff,0x02,0,0,0,0,0,0,0,0,0,0,0,0,0,0xfd}}}

// ==> QUESTION: HOW BIG DOES THIS NEED TO BE FOR REAL APPLICATIONS?
// THERE NEEDS TO BE LOGGING AND REPORTING OF OVERFLOWS SOMEHOW. DOES
// THAT HAPPEN BY JUST NACKING MESSAGES THAT COME IN WHEN THERE'S NO
// PENDING SLOT AVAILABLE?
#define NUM_PENDINGS 3

// CoAP socket FD.
static int sock = -1;

// From Section 12.3 of RFC 7252: "text/plain" content format.
static const uint8_t text_plain_format = 0;

static struct coap_pending pendings[NUM_PENDINGS];

static struct k_delayed_work retransmit_work;

// Is our LED on or off? (Not wired up to anything yet...)
static bool led_state = false;


static struct k_sem quit_lock;
static struct net_mgmt_event_callback mgmt_cb;
static bool connected;
K_SEM_DEFINE(run_app, 0, 1);
static bool want_to_quit;

#define EVENT_MASK (NET_EVENT_L4_CONNECTED | NET_EVENT_L4_DISCONNECTED)

#define STACK_SIZE 8192

#define THREAD_PRIORITY K_PRIO_PREEMPT(8)

static void process_coap(void);
static int process_client_request(void);


K_THREAD_DEFINE(coap_thread_id, STACK_SIZE,
                process_coap, NULL, NULL, NULL,
                THREAD_PRIORITY, 0, -1);


void quit(void) { k_sem_give(&quit_lock); }

static void event_handler(struct net_mgmt_event_callback *cb,
                          uint32_t mgmt_event, struct net_if *iface) {
  if ((mgmt_event & EVENT_MASK) != mgmt_event) return;

  if (want_to_quit) {
    k_sem_give(&run_app);
    want_to_quit = false;
  }

  if (mgmt_event == NET_EVENT_L4_CONNECTED) {
    LOG_INF("Network connected");
    connected = true;
    k_sem_give(&run_app);
    return;
  }

  if (mgmt_event == NET_EVENT_L4_DISCONNECTED) {
    if (!connected) {
      LOG_INF("Waiting network to be connected");
    } else {
      LOG_INF("Network disconnected");
      connected = false;
    }

    k_sem_reset(&run_app);
    return;
  }
}

static void init_app(void) {
  k_sem_init(&quit_lock, 0, UINT_MAX);

  LOG_INF("Basic CoAP server");

  net_mgmt_init_event_callback(&mgmt_cb, event_handler, EVENT_MASK);
  net_mgmt_add_event_callback(&mgmt_cb);
  net_conn_mgr_resend_status();
}


static int cmd_quit(const struct shell *shell, size_t argc, char *argv[]) {
  want_to_quit = true;
  net_conn_mgr_resend_status();
  quit();
  return 0;
}

SHELL_STATIC_SUBCMD_SET_CREATE
  (basic_coap_commands,
   SHELL_CMD(quit, NULL, "Quit the basic CoAP server application\n", cmd_quit),
   SHELL_SUBCMD_SET_END);

SHELL_CMD_REGISTER
  (basic_coap, &basic_coap_commands, "Basic CoAP server application commands",
   NULL);



static bool join_coap_multicast_group(void) {
  struct net_if *iface = net_if_get_default();
  if (!iface) {
    LOG_ERR("Could not get default interface\n");
    return false;
  }

  static struct sockaddr_in6 mcast_addr =
    { .sin6_family = AF_INET6,
      .sin6_addr = ALL_NODES_LOCAL_COAP_MCAST,
      .sin6_port = htons(COAP_PORT) };
  if (!net_if_ipv6_maddr_add(iface, &mcast_addr.sin6_addr)) {
    LOG_ERR("Cannot join IPv6 multicast group");
   return false;
  }

  return true;
}

static int start_coap_server(void) {
  // The Zephyr CoAP API doesn't have anything to do with sockets, so
  // you set up the low-level server sockets yourself. It's just a
  // simple UDP "socket + bind" thing anyway.

  struct sockaddr_in6 addr6;
  memset(&addr6, 0, sizeof(addr6));
  addr6.sin6_family = AF_INET6;
  addr6.sin6_port = htons(COAP_PORT);

  sock = socket(addr6.sin6_family, SOCK_DGRAM, IPPROTO_UDP);
  if (sock < 0) {
    LOG_ERR("Failed to create UDP socket %d", errno);
    return -errno;
  }

  int r = bind(sock, (struct sockaddr *)&addr6, sizeof(addr6));
  if (r < 0) {
    LOG_ERR("Failed to bind UDP socket %d", errno);
    return -errno;
  }

  return 0;
}

static int send_coap_reply(struct coap_packet *cpkt,
                           const struct sockaddr *addr, socklen_t addr_len) {
  hexdump("Response", cpkt->data, cpkt->offset);

  int r = sendto(sock, cpkt->data, cpkt->offset, 0, addr, addr_len);
  if (r < 0) {
    LOG_ERR("Failed to send %d", errno);
    r = -errno;
  }

  return r;
}

static int well_known_core_get(struct coap_resource *res,
                               struct coap_packet *req, struct sockaddr *addr,
                               socklen_t addr_len) {
  // This is for the "well known" CoAP resources, which are basically
  // an introspection method for learning about what "real" resources
  // are supported. The Zephyr CoAP API deals with processing these.

  uint8_t *data = (uint8_t *)k_malloc(MAX_COAP_MSG_LEN);
  if (!data)
    return -ENOMEM;

  struct coap_packet resp;
  int r = coap_well_known_core_get(res, req, &resp, data, MAX_COAP_MSG_LEN);
  if (r < 0)
    goto end;

  r = send_coap_reply(&resp, addr, addr_len);

end:
  k_free(data);
  return r;
}

static int led_get(struct coap_resource *res, struct coap_packet *req,
                   struct sockaddr *addr, socklen_t addr_len) {
  uint8_t code = coap_header_get_code(req);
  uint8_t type = coap_header_get_type(req);
  uint16_t id = coap_header_get_id(req);

  LOG_INF("led_get  type: %u code %u id %u", type, code, id);

  uint8_t *data = (uint8_t *)k_malloc(MAX_COAP_MSG_LEN);
  if (!data)
    return -ENOMEM;

  type = type == COAP_TYPE_CON ? COAP_TYPE_ACK : COAP_TYPE_NON_CON;
  struct coap_packet resp;
  uint8_t tok[8];
  uint8_t toklen = coap_header_get_token(req, tok);
  int r = coap_packet_init(&resp, data, MAX_COAP_MSG_LEN, 1, type, toklen,
                           (uint8_t *)tok, COAP_RESPONSE_CODE_CONTENT, id);
  if (r < 0)
    goto end;

  r = coap_packet_append_option(&resp, COAP_OPTION_CONTENT_FORMAT,
                                &text_plain_format, sizeof(text_plain_format));
  if (r < 0)
    goto end;

  r = coap_packet_append_payload_marker(&resp);
  if (r < 0)
    goto end;

  uint8_t payload[40];
  r = snprintk((char *)payload, sizeof(payload), "T:%u C:%u MID:%u LED:%s\n",
               type, code, id, led_state ? "ON" : "OFF");
  if (r < 0)
    goto end;

  r = coap_packet_append_payload(&resp, (uint8_t *)payload, strlen(payload));
  if (r < 0)
    goto end;

  r = send_coap_reply(&resp, addr, addr_len);

end:
  k_free(data);
  return r;
}

static int led_post(struct coap_resource *res, struct coap_packet *req,
                    struct sockaddr *addr, socklen_t addr_len) {
  uint8_t code = coap_header_get_code(req);
  uint8_t type = coap_header_get_type(req);
  uint16_t id = coap_header_get_id(req);

  LOG_INF("led_post  type: %u code %u id %u", type, code, id);

  uint16_t payload_len;
  const uint8_t *payload = coap_packet_get_payload(req, &payload_len);
  if (payload) {
    hexdump("POST Payload", payload, payload_len);
  } else {
    LOG_INF("POST with no payload!");
  }

  if (payload_len == 2 &&
      payload[0] == 'o' && payload[1] == 'n')
    led_state = true;
  else if (payload_len == 3 &&
           payload[0] == 'o' && payload[1] == 'f' && payload[2] == 'f')
    led_state = false;

  uint8_t *data = (uint8_t *)k_malloc(MAX_COAP_MSG_LEN);
  if (!data)
    return -ENOMEM;

  type = type == COAP_TYPE_CON ? COAP_TYPE_ACK : COAP_TYPE_NON_CON;
  struct coap_packet resp;
  uint8_t tok[8];
  uint8_t toklen = coap_header_get_token(req, tok);
  int r = coap_packet_init(&resp, data, MAX_COAP_MSG_LEN, 1, type, toklen,
                           (uint8_t *)tok, COAP_RESPONSE_CODE_CHANGED, id);
  if (r < 0)
    goto end;

  r = coap_packet_append_option(&resp, COAP_OPTION_CONTENT_FORMAT,
                                &text_plain_format, sizeof(text_plain_format));
  if (r < 0)
    goto end;

  r = coap_packet_append_payload_marker(&resp);
  if (r < 0)
    goto end;

  uint8_t rpayload[40];
  r = snprintk((char *)rpayload, sizeof(rpayload), "T:%u C:%u MID:%u LED:%s\n",
               type, code, id, led_state ? "ON" : "OFF");
  if (r < 0)
    goto end;

  r = coap_packet_append_payload(&resp, (uint8_t *)rpayload, strlen(rpayload));
  if (r < 0)
    goto end;

  r = send_coap_reply(&resp, addr, addr_len);

end:
  k_free(data);
  return r;
}

static void retransmit_request(struct k_work *work) {
  struct coap_pending *pending =
      coap_pending_next_to_expire(pendings, NUM_PENDINGS);
  if (!pending) return;

  if (!coap_pending_cycle(pending)) {
    k_free(pending->data);
    coap_pending_clear(pending);
    return;
  }

  k_delayed_work_submit(&retransmit_work, K_MSEC(pending->timeout));
}

static const char *const led_path[] = {"led", NULL};

static struct coap_resource resources[] = {
    { .get = well_known_core_get,
      .path = COAP_WELL_KNOWN_CORE_PATH, },
    { .get = led_get,
      .post = led_post,
      .path = led_path },
    {},
};

void start_coap(void)
{
  k_thread_name_set(coap_thread_id, "coap");
  k_thread_start(coap_thread_id);
}

void stop_coap(void)
{
  // Not a very graceful way to close a thread, but we may be blocked
  // in recvfrom call, so it seems to be necessary.
  k_thread_abort(coap_thread_id);
  if (sock >= 0) (void)close(sock);
}

static void process_coap(void) {
  // if (!join_coap_multicast_group()) goto quit;
  if (start_coap_server() < 0) goto quit;
  k_delayed_work_init(&retransmit_work, retransmit_request);

  while (true) {
    if (process_client_request() < 0) goto quit;
  }

quit:
  quit();
}

static void process_coap_request(uint8_t *data, uint16_t data_len,
                                 struct sockaddr *addr, socklen_t addr_len) {
  struct coap_packet req;
  struct coap_option options[16] = {0};
  uint8_t opt_num = 16U;
  int r = coap_packet_parse(&req, data, data_len, options, opt_num);
  if (r < 0) {
    LOG_ERR("Invalid data received (%d)\n", r);
    return;
  }

  uint8_t type = coap_header_get_type(&req);

  struct coap_pending *pending =
      coap_pending_received(&req, pendings, NUM_PENDINGS);
  if (!pending) {
    goto end;
  }

  // Clear CoAP pending request.
  if (type == COAP_TYPE_ACK) {
    k_free(pending->data);
    coap_pending_clear(pending);
  }

  return;

end:
  r = coap_handle_request(&req, resources, options, opt_num, addr, addr_len);
  if (r < 0) {
    LOG_WRN("No handler for such request (%d)\n", r);
  }
}

static int process_client_request(void) {
  struct sockaddr addr;
  socklen_t addr_len = sizeof(addr);
  uint8_t req[MAX_COAP_MSG_LEN];

  do {
    int received = recvfrom(sock, req, sizeof(req), 0, &addr, &addr_len);
    if (received < 0) {
      LOG_ERR("Connection error %d", errno);
      return -errno;
    }
    hexdump("RECEIVED", req, received);

    process_coap_request(req, received, &addr, addr_len);
  } while (true);

  return 0;
}


void main(void) {
  // Initialise application start semaphore and network connection
  // management API.
  init_app();

  // Wait for OpenThread connection.
  k_sem_take(&run_app, K_FOREVER);

  // Start CoAP handler thread.
  LOG_INF("Starting...");
  start_coap();

  // Wait for shell "basic_coap quit" command.
  k_sem_take(&quit_lock, K_FOREVER);

  // Kill CoAP server thread if it's running.
  if (connected) {
    LOG_INF("Stopping...");
    stop_coap();
  }

  LOG_DBG("Done");
}
```

## src/coap.c
```c
// Basic OpenThread CoAP server: CoAP handling.

#include <logging/log.h>
LOG_MODULE_DECLARE(basic_coap_server, LOG_LEVEL_DBG);

#include <zephyr.h>
#include <errno.h>

#include <net/coap.h>
#include <net/coap_link_format.h>
#include <net/net_ip.h>
#include <net/socket.h>
#include <net/udp.h>

#include "coap.h"
#include "utils.h"


// CoAP resource definitions: defined in endpoints.c.
extern struct coap_resource coap_resources[];

// Defined in main.c.
extern void quit(void);


// This is the IANA assigned port for CoAP.
#define COAP_PORT 5683

// This is the link local (FF02) version of the "All CoAP Nodes"
// address FF0X::FD, from the "IPv6 Multicast Address Space Registry",
// in the "Variable Scope Multicast Addresses" space (RFC 3307).
#define ALL_NODES_LOCAL_COAP_MCAST {{{0xff,0x02,0,0,0,0,0,0,0,0,0,0,0,0,0,0xfd}}}

// CoAP socket file descriptor.
static int sock = -1;


static void process_coap(void);
static int process_client_request(void);
static void process_coap_request(uint8_t *data, uint16_t data_len,
                                 struct sockaddr *addr, socklen_t addr_len);
// static bool join_coap_multicast_group(void);


// ----------------------------------------------------------------------
// CoAP SERVER THREAD DEFINITIONS

#define STACK_SIZE 8192
#define THREAD_PRIORITY K_PRIO_PREEMPT(8)

K_THREAD_DEFINE(coap_thread_id, STACK_SIZE,
                process_coap, NULL, NULL, NULL,
                THREAD_PRIORITY, 0, -1);


// ----------------------------------------------------------------------
// PUBLIC API

// Send a CoAP reply: used from the applicatio-specific endpoint
// definitions.

int send_coap_reply(struct coap_packet *cpkt,
                    const struct sockaddr *addr, socklen_t addr_len) {
  // Debug message (defined in utils.h).
  hexdump("Response", cpkt->data, cpkt->offset);

  // Use the basic socket API to send the reply data over the server
  // socket.
  int r = sendto(sock, cpkt->data, cpkt->offset, 0, addr, addr_len);
  if (r < 0) {
    LOG_ERR("Failed to send %d", errno);
    r = -errno;
  }

  return r;
}


// Send a CoAP reply for the ".well-known/core" resource introspection
// endpoint.

int well_known_core_get(struct coap_resource *res,
                        struct coap_packet *req, struct sockaddr *addr,
                        socklen_t addr_len) {
  // This is for the "well known" CoAP resources, which are basically
  // an introspection method for learning about what "real" resources
  // are supported. The Zephyr CoAP API deals with processing these.

  // Allocate reply buffer.
  uint8_t *data = (uint8_t *)k_malloc(MAX_COAP_MSG_LEN);
  if (!data) return -ENOMEM;

  // Full the reply buffer using a CoAP API function.
  struct coap_packet resp;
  int r = coap_well_known_core_get(res, req, &resp, data, MAX_COAP_MSG_LEN);
  if (r < 0) goto end;

  // Send the reply.
  r = send_coap_reply(&resp, addr, addr_len);

end:
  k_free(data);
  return r;
}


// Public interface to start the CoAP server.

void start_coap(void)
{
  k_thread_name_set(coap_thread_id, "coap");
  k_thread_start(coap_thread_id);
}


// Public interface to stop the CoAP server.

void stop_coap(void)
{
  // Not a very graceful way to close a thread, but we may be blocked
  // waiting for a network message, so there's probably no better way
  // to do it.
  k_thread_abort(coap_thread_id);
  if (sock >= 0) (void)close(sock);
}


// ----------------------------------------------------------------------
// PRIVATE FUNCTIONS

// Initialise the CoAP server. The Zephyr CoAP API doesn't have
// anything to do with sockets, so you set up the low-level server
// sockets yourself. It's just a simple UDP "socket + bind" thing
// anyway.

static int start_coap_server(void) {
  // Create a listener socket address on the well-known CoAP port.
  struct sockaddr_in6 addr6;
  memset(&addr6, 0, sizeof(addr6));
  addr6.sin6_family = AF_INET6;
  addr6.sin6_port = htons(COAP_PORT);

  // Create a UDPv6 ("datagram") socket.
  sock = socket(addr6.sin6_family, SOCK_DGRAM, IPPROTO_UDP);
  if (sock < 0) {
    LOG_ERR("Failed to create UDP socket %d", errno);
    return -errno;
  }

  // Bind the socket to our address: this means that this socket will
  // receive any messages sent to this device's CoAP port.
  int r = bind(sock, (struct sockaddr *)&addr6, sizeof(addr6));
  if (r < 0) {
    LOG_ERR("Failed to bind UDP socket %d", errno);
    return -errno;
  }

  return 0;
}


// Main server thread function: initialises CoAP server then processes
// requests as they come in. Quits on error.

static void process_coap(void) {
  // ==> NOTE: I'VE NOT BEEN ABLE TO GET THIS MULTICAST GROUP STUFF
  // WORKING YET.
  // if (!join_coap_multicast_group()) goto quit;

  // Initialise the CoAP server.
  if (start_coap_server() < 0) goto quit;

  // Process client messages, quitting if there's an error.
  // ==> NOTE: A REAL APPLICATION WOULD NEED BETTER ERROR HANDLING
  // THAN THIS!
  while (true) {
    if (process_client_request() < 0) goto quit;
  }

quit:
  quit();
}


#if 0
// Multicast setup. Still need to work out how to make this go.

static bool join_coap_multicast_group(void) {
  struct net_if *iface = net_if_get_default();
  if (!iface) {
    LOG_ERR("Could not get default interface\n");
    return false;
  }

  static struct sockaddr_in6 mcast_addr =
    { .sin6_family = AF_INET6,
      .sin6_addr = ALL_NODES_LOCAL_COAP_MCAST,
      .sin6_port = htons(COAP_PORT) };
  if (!net_if_ipv6_maddr_add(iface, &mcast_addr.sin6_addr)) {
    LOG_ERR("Cannot join IPv6 multicast group");
   return false;
  }

  return true;
}
#endif


// Process a single CoAP request from a client. This function just
// does the socket-level stuff, then hands off immediately to another
// function.

static int process_client_request(void) {
  struct sockaddr addr;
  socklen_t addr_len = sizeof(addr);
  uint8_t req[MAX_COAP_MSG_LEN];

  do {
    // Receive data from the socket. This also gets the client
    // address, which we need for sending a reply.
    int received = recvfrom(sock, req, sizeof(req), 0, &addr, &addr_len);
    if (received < 0) {
      LOG_ERR("Connection error %d", errno);
      return -errno;
    }
    hexdump("RECEIVED", req, received);

    // Hand off to the CoAP-specific processing function.
    process_coap_request(req, received, &addr, addr_len);
  } while (true);

  return 0;
}


// Process a single CoAP request for a client. This function does the
// CoAP-level packet processing.

static void process_coap_request(uint8_t *data, uint16_t data_len,
                                 struct sockaddr *addr, socklen_t addr_len) {
  // Parse received data as a CoAP packet. This gives us a coap_packet
  // structure containing the broken down request information, as well
  // as the request options pulled out into coap_option values.
  struct coap_packet req;
  struct coap_option options[16] = {0};
  uint8_t opt_num = 16U;
  int r = coap_packet_parse(&req, data, data_len, options, opt_num);
  if (r < 0) {
    LOG_ERR("Invalid data received (%d)\n", r);
    return;
  }

  // Hand the request off to the CoAP API's resource-based request
  // router. We pass in the request along with our coap_resources
  // array, which defines all the CoAP resources we support. The
  // coap_handle_request API function routes the request to the
  // appropriate endpoint handler function.
  r = coap_handle_request(&req, coap_resources, options, opt_num, addr, addr_len);
  if (r < 0) {
    LOG_WRN("No handler for such request (%d)\n", r);
  }
}
```

## src/coap.h
```c
#ifndef _H_COAP_
#define _H_COAP_

#include <net/net_ip.h>
#include <net/coap.h>

// ==> QUESTION: IS THIS DEFINED BY THE PROTOCOL, OR JUST AN
// APPLICATION LIMIT HERE?
#define MAX_COAP_MSG_LEN 256

int send_coap_reply(struct coap_packet *cpkt,
                    const struct sockaddr *addr, socklen_t addr_len);

int well_known_core_get(struct coap_resource *res,
                        struct coap_packet *req, struct sockaddr *addr,
                        socklen_t addr_len);

void start_coap(void);
void stop_coap(void);


#endif
```

## src/endpoints.c
```c
// Basic OpenThread CoAP server: CoAP endpoint definitions.

#include <logging/log.h>
LOG_MODULE_DECLARE(basic_coap_server, LOG_LEVEL_DBG);

#include <zephyr.h>
#include <errno.h>

#include <net/coap.h>
#include <net/coap_link_format.h>
#include <net/net_ip.h>

#include "coap.h"
#include "led.h"
#include "utils.h"


// From Section 12.3 of RFC 7252: "text/plain" content format.
static const uint8_t text_plain_format = 0;

// Is our LED on or off? (Not wired up to anything yet...)
static bool led_state = false;


// ----------------------------------------------------------------------
// ENDPOINT HANDLERS

// Endpoint handler for "GET led" CoAP requests.

static int led_get(struct coap_resource *res, struct coap_packet *req,
                   struct sockaddr *addr, socklen_t addr_len) {
  // The only one of these that's used for the request processing is
  // "type" (confirmable or non-confirmable). The others are retrieved
  // here just for debugging output. (The "code" is "GET" and "id" is
  // just a unique message ID.)
  uint8_t code = coap_header_get_code(req);
  uint8_t type = coap_header_get_type(req);
  uint16_t id = coap_header_get_id(req);
  LOG_INF("led_get  type: %u code %u id %u", type, code, id);

  // Allocate space for the reply.
  // ==> NOTE: IT WOULD BE WORTH FINDING OUT IF ZEPHYR HAS ANY SORT OF
  // POOL ALLOCATOR THAT COULD BE USED INSTEAD OF k_malloc. IF WE'RE
  // ALWAYS ALLOCATING BUFFERS OF THE SAME SIZE, WE COULD USE A POOL
  // ALLOCATOR TO AVOID FRAGMENTATION, WHICH MIGHT BE IMPORTANT FOR
  // LONG-RUNNING APPLICATIONS.
  uint8_t *data = (uint8_t *)k_malloc(MAX_COAP_MSG_LEN);
  if (!data) return -ENOMEM;

  // For confirmable messages, we need to send an acknowledgement type
  // packet, though we piggyback all the reply data onto that, so
  // there's not really a separate acknowledgement message.
  type = type == COAP_TYPE_CON ? COAP_TYPE_ACK : COAP_TYPE_NON_CON;

  // Build the reply packet: the "token" is retrieved from the request
  // and copied into the reply packet to allow the client to correlate
  // replies with requests. We use the "Content" response code (2.05)
  // to show that we're sending data back.
  struct coap_packet resp;
  uint8_t tok[8];
  uint8_t toklen = coap_header_get_token(req, tok);
  int r = coap_packet_init(&resp, data, MAX_COAP_MSG_LEN, 1, type, toklen,
                           (uint8_t *)tok, COAP_RESPONSE_CODE_CONTENT, id);
  if (r < 0) goto end;

  // Add a "Content-Format" option to show we're sending back plain
  // text data.
  r = coap_packet_append_option(&resp, COAP_OPTION_CONTENT_FORMAT,
                                &text_plain_format, sizeof(text_plain_format));
  if (r < 0) goto end;

  // Mark that there's a payload (this is a 0xFF byte in place of a
  // normal option marker).
  r = coap_packet_append_payload_marker(&resp);
  if (r < 0) goto end;

  // Construct the reply payload.
  uint8_t payload = led_state ? '1' : '0';

  // Append the payload.
  r = coap_packet_append_payload(&resp, &payload, 1);
  if (r < 0) goto end;

  // Send the reply: note that this is a function we're providing in
  // the coap.c file, not something that the CoAP API provides. The
  // CoAP API only concerns itself with message processing and
  // formatting. You have to deal with the socket-level side of things
  // yourself.
  r = send_coap_reply(&resp, addr, addr_len);

  // This "end:" label pattern is very common on Zephyr (and Linux
  // kernel) code. It's a clean way to provide guaranteed resource
  // cleanup on error exits in C. Don't believe people who say that
  // "goto" is dead!
end:
  k_free(data);
  return r;
}


// Endpoint handler for "PUT led" CoAP requests.

static int led_put(struct coap_resource *res, struct coap_packet *req,
                   struct sockaddr *addr, socklen_t addr_len) {
  // The only one of these that's used for the request processing is
  // "type" (confirmable or non-confirmable). The others are retrieved
  // here just for debugging output. (The "code" is "POST" and "id" is
  // just a unique message ID.)
  uint8_t code = coap_header_get_code(req);
  uint8_t type = coap_header_get_type(req);
  uint16_t id = coap_header_get_id(req);
  LOG_INF("led_put  type: %u code %u id %u", type, code, id);

  // Retrieve the PUT payload.
  uint16_t payload_len;
  const uint8_t *payload = coap_packet_get_payload(req, &payload_len);
  if (payload) {
    hexdump("PUT Payload", payload, payload_len);
  } else {
    LOG_INF("PUT with no payload!");
  }

  // Process the payload. If it's ASCII '1' or binary 1, switch the
  // LED on. If it's ASCII '0' or binary 0, switch the LED off.
  // Otherwise ignore it.
  if (payload_len >= 1) {
    if (payload[0] == '1' || payload[0] == 1) {
      led_state = true;
      led_on();
    } else if (payload[0] == '0' || payload[0] == 0) {
      led_state = false;
      led_off();
    }
  }

  // Allocate space for the reply.
  uint8_t *data = (uint8_t *)k_malloc(MAX_COAP_MSG_LEN);
  if (!data) return -ENOMEM;

  // For confirmable messages, we need to send an acknowledgement type
  // packet, though we piggyback all the reply data onto that, so
  // there's not really a separate acknowledgement message.
  type = type == COAP_TYPE_CON ? COAP_TYPE_ACK : COAP_TYPE_NON_CON;

  // Build the reply packet: the "token" is retrieved from the request
  // and copied into the reply packet to allow the client to correlate
  // replies with requests. We use the "Changed" response code (2.04)
  // to show that we may have modified the status of the requested
  // resource.
  struct coap_packet resp;
  uint8_t tok[8];
  uint8_t toklen = coap_header_get_token(req, tok);
  int r = coap_packet_init(&resp, data, MAX_COAP_MSG_LEN, 1, type, toklen,
                           (uint8_t *)tok, COAP_RESPONSE_CODE_CHANGED, id);
  if (r < 0) goto end;

  // Add a "Content-Format" option to show we're sending back plain
  // text data.
  r = coap_packet_append_option(&resp, COAP_OPTION_CONTENT_FORMAT,
                                &text_plain_format, sizeof(text_plain_format));
  if (r < 0) goto end;

  // Mark that there's a payload (this is a 0xFF byte in place of a
  // normal option marker).
  r = coap_packet_append_payload_marker(&resp);
  if (r < 0) goto end;

  // Construct the reply payload.
  uint8_t rpayload = led_state ? '1' : '0';

  // Append the payload.
  r = coap_packet_append_payload(&resp, &rpayload, 1);
  if (r < 0) goto end;

  // Send the reply.
  r = send_coap_reply(&resp, addr, addr_len);

  // Clean up on exit.
end:
  k_free(data);
  return r;
}


// ----------------------------------------------------------------------
// CoAP RESOURCE DEFINITIONS

// URI path for our LED resource.
static const char *const led_path[] = {"led", NULL};

struct coap_resource coap_resources[] = {
  // Include the ".well-known/core" resource: this is handled by a
  // common function defined in coap.c.
  { .get = well_known_core_get,
    .path = COAP_WELL_KNOWN_CORE_PATH, },

  // Our LED resource: we have GET and PUT endpoints, and specify the
  // URI path to the resource.
  { .get = led_get,
    .put = led_put,
    .path = led_path },

  // End marker.
  {},
};
```

## src/endpoints.h
```c
#ifndef _H_ENDPOINTS_
#define _H_ENDPOINTS_

#include <net/coap.h>

extern struct coap_resource coap_resources[];

#endif
```

## src/led.c
```c
// Basic OpenThread CoAP server: LED control.

#include <logging/log.h>
LOG_MODULE_DECLARE(basic_coap_server, LOG_LEVEL_DBG);

#include <zephyr.h>
#include <device.h>
#include <devicetree.h>
#include <drivers/gpio.h>

#include "led.h"

// The devicetree node identifier for the "led0" alias.
#define LED0_NODE DT_ALIAS(led0)

#if DT_NODE_HAS_STATUS(LED0_NODE, okay)
#define LED0  DT_GPIO_LABEL(LED0_NODE, gpios)
#define PIN DT_GPIO_PIN(LED0_NODE, gpios)
#define FLAGS DT_GPIO_FLAGS(LED0_NODE, gpios)
#else
// A build error here means your board isn't set up to blink an LED.
#error "Unsupported board: led0 devicetree alias is not defined"
#define LED0  ""
#define PIN 0
#define FLAGS 0
#endif


const static struct device *dev;

bool init_led(void) {
  dev = device_get_binding(LED0);
  if (dev == NULL) return false;

  int ret = gpio_pin_configure(dev, PIN, GPIO_OUTPUT_ACTIVE | FLAGS);
  if (ret < 0) return false;

  led_off();
  return true;
}

void led_on(void) {
  LOG_DBG("===> LED ON");
  gpio_pin_set(dev, PIN, true);
}

void led_off(void) {
  LOG_DBG("===> LED OFF");
  gpio_pin_set(dev, PIN, false);
}
```

## src/led.h
```c
#ifndef _H_LED_
#define _H_LED_

bool init_led(void);

void led_on(void);
void led_off(void);

#endif
```

## src/utils.h
```c
#ifndef _H_UTILS_
#define _H_UTILS_

#include <zephyr.h>

static inline void hexdump(const char *str, const uint8_t *pkt, size_t len) {
  if (!len) {
    LOG_DBG("%s zero-length packet", str);
    return;
  }
  LOG_HEXDUMP_DBG(pkt, len, str);
}


#endif
```
